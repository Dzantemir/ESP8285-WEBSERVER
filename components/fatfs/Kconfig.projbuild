## components/fatfs/Kconfig.projbuild
```kconfig
menu "FAT Filesystem support"

    # =========================================================================
    #  Function Configurations
    # =========================================================================

    config FATFS_FS_READONLY
        bool "Read-only filesystem"
        default n
        help
            Enable read-only configuration (FF_FS_READONLY = 1).
            This removes writing API functions: f_write(), f_sync(),
            f_unlink(), f_mkdir(), f_chmod(), f_rename(), f_truncate(),
            f_getfree() and optional writing functions as well.
            Enable this option to reduce code size when write access is not needed.

    choice FATFS_MINIMIZE
        prompt "Minimization level"
        default FATFS_MINIMIZE_0
        help
            Select minimization level to remove some basic API functions
            and reduce code size (FF_FS_MINIMIZE).

            0: Basic functions are fully enabled.
            1: f_stat(), f_getfree(), f_unlink(), f_mkdir(), f_truncate()
               and f_rename() are removed.
            2: f_opendir(), f_readdir() and f_closedir() are removed in
               addition to 1.
            3: f_lseek() function is removed in addition to 2.

        config FATFS_MINIMIZE_0
            bool "0: Full function set"
        config FATFS_MINIMIZE_1
            bool "1: Remove f_stat, f_getfree, f_unlink, f_mkdir, f_truncate, f_rename"
        config FATFS_MINIMIZE_2
            bool "2: Remove f_opendir, f_readdir, f_closedir in addition to 1"
        config FATFS_MINIMIZE_3
            bool "3: Remove f_lseek in addition to 2"
    endchoice

    config FATFS_USE_FIND
        bool "Enable filtered directory read functions (f_findfirst, f_findnext)"
        default n
        help
            Enable filtered directory read functions, f_findfirst() and
            f_findnext() (FF_USE_FIND = 1). Useful for pattern-based
            file searching in directories.

    config FATFS_USE_MKFS
        bool "Enable f_mkfs() (format filesystem)"
        default y
        help
            Enable f_mkfs() function to create a FAT volume on the
            logical drive (FF_USE_MKFS = 1). Disable this if you never
            need to format filesystems at runtime to save code size.

    config FATFS_USE_FASTSEEK
        bool "Enable fast seek feature"
        default n
        help
            Enable fast seek feature (FF_USE_FASTSEEK = 1). This enables
            f_lseek() to use a cluster link map table (CLMT) for faster
            file seeking, especially useful for large files. When enabled,
            the application can set fp->cltbl before calling f_lseek().

    config FATFS_USE_EXPAND
        bool "Enable f_expand() (pre-allocate contiguous clusters)"
        default n
        help
            Enable f_expand() function (FF_USE_EXPAND = 1). This function
            allocates a contiguous data area to the file. Useful for
            preventing file fragmentation and ensuring consistent write
            performance. Also FF_FS_READONLY needs to be 0 to enable this.

    config FATFS_USE_CHMOD
        bool "Enable attribute control functions (f_chmod, f_utime)"
        default y
        depends on !FATFS_FS_READONLY
        help
            Enable attribute control API functions, f_chmod() and f_utime()
            (FF_USE_CHMOD = 1). f_chmod() changes file attributes and
            f_utime() changes file timestamps. Disable to save code size
            if these are not needed.

    config FATFS_USE_LABEL
        bool "Enable volume label functions (f_getlabel, f_setlabel)"
        default n
        help
            Enable volume label API functions, f_getlabel() and f_setlabel()
            (FF_USE_LABEL = 1). Disable if you don't need to read or set
            volume labels.

    config FATFS_USE_FORWARD
        bool "Enable f_forward() function"
        default n
        help
            Enable f_forward() function (FF_USE_FORWARD = 1). This function
            forwards file data to the stream directly. Useful when you want
            to stream file data without intermediate buffer.

    choice FATFS_USE_STRFUNC
        prompt "String I/O functions (f_printf, f_puts, f_gets, f_putc)"
        default FATFS_USE_STRFUNC_NONE
        help
            Enable string API functions (FF_USE_STRFUNC).

            0: Disable. No string I/O functions.
            1: Enable without LF-CRLF conversion.
            2: Enable with LF-CRLF conversion.

        config FATFS_USE_STRFUNC_NONE
            bool "Disabled"
        config FATFS_USE_STRFUNC_WITHOUT_CRLF
            bool "Enabled without LF-CRLF conversion"
        config FATFS_USE_STRFUNC_WITH_CRLF
            bool "Enabled with LF-CRLF conversion"
    endchoice

    config FATFS_PRINT_LLI
        bool "Support long long argument in f_printf (%lld, %llu)"
        default n
        depends on FATFS_USE_STRFUNC_WITHOUT_CRLF || FATFS_USE_STRFUNC_WITH_CRLF
        help
            Enable long long integer support in f_printf() (FF_PRINT_LLI = 1).
            This makes f_printf() support %lld and %llu format specifiers.
            Requires C99 or later. Only effective when string I/O functions
            are enabled. Increases code size slightly.

    config FATFS_PRINT_FLOAT
        bool "Support floating point argument in f_printf (%f)"
        default n
        depends on FATFS_USE_STRFUNC_WITHOUT_CRLF || FATFS_USE_STRFUNC_WITH_CRLF
        help
            Enable floating point support in f_printf() (FF_PRINT_FLOAT = 1).
            When enabled, f_printf() supports %f and related format specifiers.
            Requires C99 or later. Only effective when string I/O functions
            are enabled. Increases code size.

    choice FATFS_STRF_ENCODE
        prompt "Character encoding for string I/O functions"
        depends on (FATFS_USE_STRFUNC_WITHOUT_CRLF || FATFS_USE_STRFUNC_WITH_CRLF) && !FATFS_LFN_NONE
        default FATFS_STRF_ENCODE_UTF8
        help
            Select character encoding assumed on the file for string I/O
            functions (FF_STRF_ENCODE). Only effective when both string I/O
            functions and LFN are enabled.

            0: ANSI/OEM in current CP
            1: Unicode in UTF-16LE
            2: Unicode in UTF-16BE
            3: Unicode in UTF-8

        config FATFS_STRF_ENCODE_ANSI
            bool "ANSI/OEM in current CP"
        config FATFS_STRF_ENCODE_UTF16LE
            bool "Unicode in UTF-16LE"
        config FATFS_STRF_ENCODE_UTF16BE
            bool "Unicode in UTF-16BE"
        config FATFS_STRF_ENCODE_UTF8
            bool "Unicode in UTF-8"
    endchoice

    # =========================================================================
    #  Locale and Namespace Configurations
    # =========================================================================

    choice FATFS_CHOOSE_CODEPAGE
        prompt "OEM Code Page"
        default FATFS_CODEPAGE_437
        help
            OEM code page used for file name encodings.

            If "Dynamic" is selected, code page can be chosen at runtime using
            f_setcp function. Note that choosing this option will increase
            application size by ~480kB.

        config FATFS_CODEPAGE_DYNAMIC
            bool "Dynamic (all code pages supported)"
        config FATFS_CODEPAGE_437
            bool "US (CP437)"
        config FATFS_CODEPAGE_720
            bool "Arabic (CP720)"
        config FATFS_CODEPAGE_737
            bool "Greek (CP737)"
        config FATFS_CODEPAGE_771
            bool "KBL (CP771)"
        config FATFS_CODEPAGE_775
            bool "Baltic (CP775)"
        config FATFS_CODEPAGE_850
            bool "Latin 1 (CP850)"
        config FATFS_CODEPAGE_852
            bool "Latin 2 (CP852)"
        config FATFS_CODEPAGE_855
            bool "Cyrillic (CP855)"
        config FATFS_CODEPAGE_857
            bool "Turkish (CP857)"
        config FATFS_CODEPAGE_860
            bool "Portugese (CP860)"
        config FATFS_CODEPAGE_861
            bool "Icelandic (CP861)"
        config FATFS_CODEPAGE_862
            bool "Hebrew (CP862)"
        config FATFS_CODEPAGE_863
            bool "Canadian French (CP863)"
        config FATFS_CODEPAGE_864
            bool "Arabic (CP864)"
        config FATFS_CODEPAGE_865
            bool "Nordic (CP865)"
        config FATFS_CODEPAGE_866
            bool "Russian (CP866)"
        config FATFS_CODEPAGE_869
            bool "Greek 2 (CP869)"
        config FATFS_CODEPAGE_932
            bool "Japanese (DBCS) (CP932)"
        config FATFS_CODEPAGE_936
            bool "Simplified Chinese (DBCS) (CP936)"
        config FATFS_CODEPAGE_949
            bool "Korean (DBCS) (CP949)"
        config FATFS_CODEPAGE_950
            bool "Traditional Chinese (DBCS) (CP950)"

    endchoice

    config FATFS_CODEPAGE
        int
        default 0 if FATFS_CODEPAGE_DYNAMIC
        default 437 if FATFS_CODEPAGE_437
        default 720 if FATFS_CODEPAGE_720
        default 737 if FATFS_CODEPAGE_737
        default 771 if FATFS_CODEPAGE_771
        default 775 if FATFS_CODEPAGE_775
        default 850 if FATFS_CODEPAGE_850
        default 852 if FATFS_CODEPAGE_852
        default 855 if FATFS_CODEPAGE_855
        default 857 if FATFS_CODEPAGE_857
        default 860 if FATFS_CODEPAGE_860
        default 861 if FATFS_CODEPAGE_861
        default 862 if FATFS_CODEPAGE_862
        default 863 if FATFS_CODEPAGE_863
        default 864 if FATFS_CODEPAGE_864
        default 865 if FATFS_CODEPAGE_865
        default 866 if FATFS_CODEPAGE_866
        default 869 if FATFS_CODEPAGE_869
        default 932 if FATFS_CODEPAGE_932
        default 936 if FATFS_CODEPAGE_936
        default 949 if FATFS_CODEPAGE_949
        default 950 if FATFS_CODEPAGE_950
        default 437

    choice FATFS_LONG_FILENAMES
        prompt "Long filename support"
        default FATFS_LFN_NONE
        help
            Support long filenames in FAT. Long filename data increases
            memory usage. FATFS can be configured to store the buffer for
            long filename data in stack or heap.

        config FATFS_LFN_NONE
            bool "No long filenames"
        config FATFS_LFN_HEAP
            bool "Long filename buffer in heap"
        config FATFS_LFN_STACK
            bool "Long filename buffer on stack"
    endchoice

    config FATFS_MAX_LFN
        int "Max long filename length"
        depends on !FATFS_LFN_NONE
        default 255
        range 12 255
        help
            Maximum long filename length (FF_MAX_LFN). Can be reduced to save RAM.
            Recommended value is 255 to fully support the LFN specification.

    choice FATFS_API_ENCODING
        prompt "API character encoding"
        depends on !FATFS_LFN_NONE
        default FATFS_API_ENCODING_ANSI_OEM
        help
            Choose encoding for character and string arguments/returns when using
            FATFS APIs (FF_LFN_UNICODE). The encoding of arguments will usually
            depend on text editor settings.

            0: ANSI/OEM in current CP (TCHAR = char)
            1: Unicode in UTF-16 (TCHAR = WCHAR)
            2: Unicode in UTF-8 (TCHAR = char)
            3: Unicode in UTF-32 (TCHAR = DWORD)

        config FATFS_API_ENCODING_ANSI_OEM
            bool "API uses ANSI/OEM encoding"
        config FATFS_API_ENCODING_UTF_16
            bool "API uses UTF-16 encoding"
        config FATFS_API_ENCODING_UTF_8
            bool "API uses UTF-8 encoding"
        config FATFS_API_ENCODING_UTF_32
            bool "API uses UTF-32 encoding"
    endchoice

    config FATFS_LFN_BUF
        int "Long filename buffer size in FILINFO (FF_LFN_BUF)"
        depends on !FATFS_LFN_NONE
        default 255
        range 12 255
        help
            Size of the file name member (fname[]) in the FILINFO structure
            for long filenames. Reducing this value saves RAM per FILINFO
            instance, but long filenames will be truncated if they exceed
            this length. Only effective when LFN is enabled.

    config FATFS_SFN_BUF
        int "Short filename buffer size in FILINFO (FF_SFN_BUF)"
        depends on !FATFS_LFN_NONE
        default 12
        range 12 255
        help
            Size of the alternative file name member (altname[]) in the
            FILINFO structure for short (8.3) filenames. 12 is the minimum
            for standard 8.3 format. Only effective when LFN is enabled.

    choice FATFS_FS_RPATH
        prompt "Relative path support"
        default FATFS_FS_RPATH_0
        help
            Configure support for relative path feature (FF_FS_RPATH).

            0: Disable relative path and remove related API functions.
            1: Enable relative path and dot names. f_chdir() and f_chdrive()
               are available.
            2: f_getcwd() is available in addition to 1.

        config FATFS_FS_RPATH_0
            bool "0: Disable relative path"
        config FATFS_FS_RPATH_1
            bool "1: Enable f_chdir() and f_chdrive()"
        config FATFS_FS_RPATH_2
            bool "2: Enable f_getcwd() in addition to 1"
    endchoice

    # =========================================================================
    #  Drive/Volume Configurations
    # =========================================================================

    config FATFS_VOLUMES
        int "Number of volumes (logical drives)"
        default 2
        range 1 10
        help
            Number of volumes (logical drives) to be used (FF_VOLUMES).
            Minimum is 1, maximum is 10. Each volume uses a small amount
            of static RAM for internal structures. Set to the minimum
            needed to save RAM on ESP8266.

    config FATFS_STR_VOLUME_ID
        bool "Use string volume IDs in path name"
        default n
        help
            Enable support for volume ID in arbitrary strings
            (FF_STR_VOLUME_ID = 1). When enabled, you can use drive
            number in the path name as arbitrary strings defined by
            "Volume ID strings" option, e.g. "sd:file.txt" instead of
            "0:file.txt".

    # NOTE: FF_VOLUME_STRS is hardcoded in ffconf.h as "RAM","NAND","CF","SD","SD2","USB","USB2","USB3"
    # The Kconfig 'string' type with complex default values causes cmake syntax errors
    # in the ESP8266_RTOS_SDK build system. To change volume ID strings, edit ffconf.h.

    config FATFS_MULTI_PARTITION
        bool "Support multiple partitions on physical drive"
        default n
        help
            Enable support for multiple volumes on the physical drive
            (FF_MULTI_PARTITION = 1). When enabled, each logical drive
            number can be bound to arbitrary physical drive and partition
            listed in the VolToPart[] table. Also f_fdisk() will be
            available. Most ESP8266 configurations use a single partition,
            so this can usually be disabled.

    config FATFS_LBA64
        bool "Support 64-bit LBA (drives > 2TB)"
        default n
        depends on FATFS_FS_EXFAT
        help
            Enable support for 64-bit LBA (FF_LBA64 = 1). This is needed
            for storage devices larger than 2TB. To enable this, exFAT
            must also be enabled. Not typically needed on ESP8266.

    config FATFS_MIN_GPT
        int "Minimum sectors to switch GPT in f_mkfs/f_fdisk (decimal)"
        depends on FATFS_LBA64
        default 268435456
        help
            Minimum number of sectors to switch GPT as partitioning format
            in f_mkfs() and f_fdisk() (FF_MIN_GPT). Maximum 2^32 sectors.
            This option has no effect when FATFS_LBA64 is disabled.
            Default 268435456 (0x10000000 = ~256MB worth of sectors).

    config FATFS_USE_TRIM
        bool "Enable ATA-TRIM support"
        default n
        help
            Enable support for ATA-TRIM (FF_USE_TRIM = 1). When enabled,
            FatFs can send TRIM commands to the storage device to release
            unused data blocks. Useful with wear levelling flash to improve
            wear distribution. To enable this, CTRL_TRIM command should be
            implemented in disk_ioctl().

    # =========================================================================
    #  System Configurations
    # =========================================================================

    config FATFS_FS_EXFAT
        bool "Enable exFAT filesystem support"
        default n
        depends on !FATFS_LFN_NONE
        help
            Enable support for exFAT filesystem (FF_FS_EXFAT = 1).
            To enable exFAT, LFN must also be enabled.
            Note that enabling exFAT discards ANSI C (C89) compatibility
            and increases code size. exFAT is needed for volumes larger
            than 32GB.

    config FATFS_FS_NORTC
        bool "Disable timestamp feature (no RTC)"
        default n
        depends on !FATFS_FS_READONLY
        help
            Disable the timestamp feature (FF_FS_NORTC = 1). If the system
            does not have an RTC or valid timestamp is not needed, enable
            this option. Every object modified by FatFs will have a fixed
            timestamp defined by the NORTC year/month/day options below.
            When disabled (FF_FS_NORTC = 0), get_fattime() must be provided
            by the application to read current time from real-time clock.

    config FATFS_NORTC_YEAR
        int "Fixed timestamp year (when RTC disabled)"
        depends on FATFS_FS_NORTC
        default 2025
        range 1980 2107
        help
            Year value used for fixed timestamp when FATFS_FS_NORTC is enabled
            (FF_NORTC_YEAR). FAT year range is 1980-2107.

    config FATFS_NORTC_MON
        int "Fixed timestamp month (when RTC disabled)"
        depends on FATFS_FS_NORTC
        default 1
        range 1 12
        help
            Month value used for fixed timestamp when FATFS_FS_NORTC is enabled
            (FF_NORTC_MON).

    config FATFS_NORTC_MDAY
        int "Fixed timestamp day (when RTC disabled)"
        depends on FATFS_FS_NORTC
        default 1
        range 1 31
        help
            Day value used for fixed timestamp when FATFS_FS_NORTC is enabled
            (FF_NORTC_MDAY).

    config FATFS_PATH_DEPTH
        int "Maximum directory depth in exFAT (FF_PATH_DEPTH)"
        depends on FATFS_FS_EXFAT
        default 10
        range 1 255
        help
            Maximum depth of directory in the exFAT volume. This option is
            NOT relevant to FAT/FAT32 volumes. Only effective when both
            exFAT and relative path support are enabled.

    config FATFS_FS_CRTIME
        bool "Store file creation time"
        default n
        help
            Enable the timestamp of the file creation (FF_FS_CRTIME = 1).
            When enabled, the file creation time is available in the FILINFO
            structure (crdate and crtime fields). This adds 4 bytes to FILINFO.

    config FATFS_FS_NOFSINFO
        int "FSINFO trust level on FAT32 volume"
        default 0
        range 0 3
        help
            Control use of FSINFO on FAT32 volume (FF_FS_NOFSINFO).

            If you need to know the correct free space on the FAT32 volume,
            set bit 0 of this option, and f_getfree() on the first time after
            volume mount will force a full FAT scan.

            bit0=0: Use free cluster count in the FSINFO if available.
            bit0=1: Do not trust free cluster count in the FSINFO.
            bit1=0: Use last allocated cluster number in the FSINFO if available.
            bit1=1: Do not trust last allocated cluster number in the FSINFO.

    config FATFS_FS_LOCK
        int "Number of simultaneously open files protected by lock function"
        default 0
        range 0 65535
        help
            This option sets the FATFS configuration value FF_FS_LOCK.
            The option FF_FS_LOCK switches file lock function to control duplicated
            file open and illegal operation to open objects.

            * 0: Disable file lock function. To avoid volume corruption, application
            should avoid illegal open, remove and rename to the open objects.

            * >0: Enable file lock function. The value defines how many files/sub-directories
            can be opened simultaneously under file lock control.

            Note that the file lock control is independent of re-entrancy.

    config FATFS_TIMEOUT_MS
        int "Timeout for acquiring a file lock, ms"
        default 10000
        help
            This option sets FATFS configuration value FF_FS_TIMEOUT, scaled to
            milliseconds. Sets the number of milliseconds FATFS will wait to acquire
            a mutex when operating on an open file. For example, if one task is
            performing a lengthy operation, another task will wait for the first
            task to release the lock, and time out after amount of time set by
            this option.

    config FATFS_PER_FILE_CACHE
        bool "Use separate cache for each file"
        default y
        help
            This option affects FATFS configuration value FF_FS_TINY.

            If this option is set, FF_FS_TINY is 0, and each open file has its own
            cache, size of the cache is equal to the FF_MAX_SS variable
            (512 or 4096 bytes). This option uses more RAM if more than 1 file
            is open, but needs less reads and writes to the storage for some
            operations.

            If this option is not set, FF_FS_TINY is 1, and single cache is used
            for all open files, size is also equal to FF_MAX_SS variable. This
            reduces the amount of heap used when multiple files are open, but
            increases the number of read and write operations which FATFS needs
            to make.

    config FATFS_ALLOC_PREFER_EXTRAM
        bool "Prefer external RAM when allocating FATFS buffers"
        default y
        depends on SPIRAM_USE_CAPS_ALLOC || SPIRAM_USE_MALLOC
        help
            When the option is enabled, internal buffers used by FATFS will be
            allocated from external RAM. If the allocation from external RAM fails,
            the buffer will be allocated from the internal RAM.
            Disable this option if optimizing for performance. Enable this option
            if optimizing for internal memory size.

endmenu
```
